## platforms/zephyr/boards/waveshare/esp32h2_dev_kit_n4/board.yml
```yaml
board:
  name: esp32h2_dev_kit_n4
  full_name: Waveshare ESP32-H2-DEV-KIT-N4
  vendor: waveshare
  socs:
  - name: esp32h2
```
